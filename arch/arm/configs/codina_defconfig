## arch/arm/mach-ux500/Kconfig
```kconfig
if ARCH_U8500

config UX500_SOC_COMMON
	bool
	default y
	select ARM_GIC
	select NOMADIK_GPIO
	select PL310_ERRATA_753970
	select ARM_ERRATA_754322
	select ARM_ERRATA_764369
	select CACHE_L2X0
	select HAS_MTU

config UX500_SOC_DBX500
	depends on UX500_SOC_DB5500 || UX500_SOC_DB8500
	bool

config UX500_SOC_DB5500
	bool
	select MFD_DB5500_PRCMU
	select REGULATOR_DB5500_PRCMU
	select UX500_SOC_DBX500

config UX500_SOC_DB8500
	bool
	select UX500_SOC_DBX500
	select MFD_DB8500_PRCMU
	select REGULATOR
	select REGULATOR_DB8500_PRCMU
	select CPU_FREQ_TABLE if CPU_FREQ

menu "Ux500 target platform (boards)"

config MACH_MOP500
	bool "U8500 Development platform, MOP500 versions"
	select UX500_SOC_DB8500
	select I2C
	select I2C_NOMADIK
	select SOC_BUS
	help
	  Include support for the MOP500 development platform.

config MACH_HREFV60
	bool "U8500 Development platform, HREFv60 version"
	select MACH_MOP500
	help
	  Include support for the HREFv60 new development platform.
	  Includes HREFv70, v71 etc.

config MACH_U8520
       bool "U8520 Development platform"
       depends on UX500_SOC_DB8500
	select MACH_U8500
       help
         Include support for the 8520 development platform.

config MACH_SNOWBALL
	bool "U8500 Snowball platform"
	select MACH_MOP500
	help
	  Include support for the snowball development platform.

config MACH_U5500
	bool "U5500 Development platform"
	select UX500_SOC_DB5500
	help
	  Include support for the U5500 development platform.

config MACH_U9540
	bool "U9540 Development platform"
	depends on UX500_SOC_DB8500
	select MACH_U8500
	help
	  Include support for the U9540 development platform.

config UX500_AUTO_PLATFORM
	def_bool y
	depends on !MACH_U5500
	select MACH_MOP500
	help
	  At least one platform needs to be selected in order to build
	  a working kernel. If everything else is disabled, this
	  automatically enables MACH_MOP500.

config MACH_UX500_DT
	bool "Generic U8500 support using device tree"
	depends on MACH_MOP500
	select USE_OF

endmenu

choice
	prompt "Ux500 UIB Keylayout"
	default KEYLAYOUT_LAYOUT1

config KEYLAYOUT_LAYOUT1
	bool "UIB Keylayout 1; for generic users"
	help
	  Supported keylayout for some numerics, power/call buttons,
	  volume control etc

config KEYLAYOUT_LAYOUT2
	bool "UIB Keylayout 2; for connectivity users"
	help
	  Supports keylayout numerics 0-9, left/right/up/down/back/
	  enter keys and special character "."(dot)

endchoice

choice
	prompt "DBx500 sched_clock"

config DBX500_SCHED_CLOCK_PRCMU
	bool "PRCMU Timer sched_clock"
	depends on CLKSRC_DBX500_PRCMU
	select CLKSRC_DBX500_PRCMU_SCHED_CLOCK
	help
	  Use the always on PRCMU Timer as sched_clock

config DB5500_MTIMER_SCHED_CLOCK
	bool "MTIMER sched_clock"
	depends on CLKSRC_DB5500_MTIMER
	select CLKSRC_DB5500_MTIMER_SCHED_CLOCK
	help
	  Use the always on MTIMER as sched_clock

config DBX500_MTU_SCHED_CLOCK
	bool "MTU sched_clock"
	depends on HAS_MTU
	select NOMADIK_MTU_SCHED_CLOCK
	help
	  Use the Multi Timer Unit as the sched_clock.

endchoice

config UX500_DEBUG_UART
	int "Ux500 UART to use for low-level debug"
	default 2
	help
	  Choose the UART on which kernel low-level debug messages should be
	  output.

config UX500_GPIO_KEYS
        bool "Use gpio-keys for proximity and hal sensors"
        depends on KEYBOARD_GPIO
        help
	  Add proximity and hal sensors as a gpio keyboard.

config U5500_MODEM_IRQ
	bool "Modem IRQ support"
	depends on UX500_SOC_DB5500
	default y
	help
	  Add support for handling IRQ:s from modem side

config DBX500_PRCMU_DEBUG
	bool "DBX500 PRCMU debug"
	depends on ((MFD_DB5500_PRCMU || MFD_DB8500_PRCMU) && DEBUG_FS)
	help
	  Add support for PRCMU debug

config TEE_UX500
	bool "Trusted Execution Environment (TEE) ux500 hardware support"
	depends on TEE_SUPPORT
	default y
	help
	  Adds TEE hardware support for ux500 platforms.

config TEE_SVP
	bool "Trusted Execution Environment (TEE) ux500 SVP support"
	depends on TEE_SUPPORT && UX500_SVP
	default y
	help
	  Adds TEE support for SVP in ux500 platforms.

config UX500_DEBUG_HWREG
	bool "Debug hardware registers from userspace"
	depends on (DEBUG_FS && UX500_SOC_DB8500)
	help
	  Adds various debug files to access registers.
	  This should never ever be used for anything else than debugging.

config UX500_DEBUG_NO_LAUTERBACH
       bool "Disable clocks needed for Lauterbach debugging"
       help
	  Disable clocks needed for Lauterbach debugging at boot.
	  If yes, you will reduce the power consumption.

config UX500_L2X0_PREFETCH_CTRL
	bool "PL310 prefetch control"
	depends on (UX500_SOC_DB8500 || UX500_SOC_DB5500) && \
			(TEE_UX500 && CACHE_L2X0)
	default y
	help
	  Adds interface to control instruction and data prefetch.
	  Communication with Trustzone is done through TEE driver.

config UX500_DB_DUMP
	bool "DBx500 register dump on crash"
	depends on (UX500_SOC_DB8500 || UX500_SOC_DB5500)
	default y
	help
	  Reads specific DBx500 register in case of kernel crash
	  and saves it.

source "arch/arm/mach-ux500/pm/Kconfig"
source "arch/arm/mach-ux500/test/Kconfig"

endif
```

## arch/arm/mach-ux500/drivers/Kconfig
```kconfig
menu "Device Drivers"

config ARM_UX500_AMBA
	bool
	default y

#source "arch/arm/mach-ux500/drivers/base/Kconfig"

#source "arch/arm/mach-ux500/drivers/battery/Kconfig"

# misc before ide - BLK_DEV_SGIIOC4 depends on SGI_IOC4

source "arch/arm/mach-ux500/drivers/misc/Kconfig"

#source "arch/arm/mach-ux500/drivers/scsi/Kconfig"

#source "arch/arm/mach-ux500/drivers/net/Kconfig"

#source "arch/arm/mach-ux500/drivers/input/Kconfig"

#source "arch/arm/mach-ux500/drivers/char/Kconfig"

#source "arch/arm/mach-ux500/drivers/i2c/Kconfig"

#source "arch/arm/mach-ux500/drivers/spi/Kconfig"

#source "arch/arm/mach-ux500/drivers/gpio/Kconfig"

#source "arch/arm/mach-ux500/drivers/power/Kconfig"

#source "arch/arm/mach-ux500/drivers/hwmon/Kconfig"

#source "arch/arm/mach-ux500/drivers/watchdog/Kconfig"

#source "arch/arm/mach-ux500/drivers/mfd/Kconfig"

#source "arch/arm/mach-ux500/drivers/regulator/Kconfig"

#source "arch/arm/mach-ux500/drivers/video/Kconfig"

#source "arch/arm/mach-ux500/drivers/usb/Kconfig"

#source "arch/arm/mach-ux500/drivers/mmc/Kconfig"

#source "arch/arm/mach-ux500/drivers/rtc/Kconfig"

#source "arch/arm/mach-ux500/drivers/dma/Kconfig"

#source "arch/arm/mach-ux500/drivers/staging/Kconfig"

#source "arch/arm/mach-ux500/drivers/clk/Kconfig"

#source "arch/arm/mach-ux500/drivers/tee/Kconfig"

#source "arch/arm/mach-ux500/drivers/clocksource/Kconfig"

#source "arch/arm/mach-ux500/drivers/modem/Kconfig"

#source "arch/arm/mach-ux500/drivers/samsung/Kconfig"

#source "arch/arm/mach-ux500/drivers/sensor/Kconfig"

#source "arch/arm/mach-ux500/drivers/phone_svn/Kconfig"

endmenu
```

## arch/arm/mach-ux500/drivers/char/Kconfig
```kconfig
#
# Character device configuration
#

menu "Character devices"
source "drivers/char/hwreg/Kconfig"
source "drivers/char/hw_random/Kconfig"
endmenu
```

## arch/arm/mach-ux500/drivers/dma/Kconfig
```kconfig
config STE_DMA40
	bool "ST-Ericsson DMA40 support"
	depends on ARCH_U8500
	select DMA_ENGINE
	help
	  Support for ST-Ericsson DMA40 controller
```

## arch/arm/mach-ux500/drivers/gpio/Kconfig
```kconfig
#
# GPIO infrastructure and drivers
#

config ARCH_WANT_OPTIONAL_GPIOLIB
	bool
	help
	  Select this config option from the architecture Kconfig, if
	  it is possible to use gpiolib on the architecture, but let the
	  user decide whether to actually build it or not.
	  Select this instead of ARCH_REQUIRE_GPIOLIB, if your architecture does
	  not depend on GPIOs being available, but rather let the user
	  decide whether he needs it or not.

config ARCH_REQUIRE_GPIOLIB
	bool
	select GPIOLIB
	help
	  Platforms select gpiolib if they use this infrastructure
	  for all their GPIOs, usually starting with ones integrated
	  into SOC processors.
	  Selecting this from the architecture code will cause the gpiolib
	  code to always get built in.



menuconfig GPIOLIB
	bool "GPIO Support"
	depends on ARCH_WANT_OPTIONAL_GPIOLIB || ARCH_REQUIRE_GPIOLIB
	select GENERIC_GPIO
	help
	  This enables GPIO support through the generic GPIO library.
	  You only need to enable this, if you also want to enable
	  one or more of the GPIO drivers below.

	  If unsure, say N.

if GPIOLIB

config DEBUG_GPIO
	bool "Debug GPIO calls"
	depends on DEBUG_KERNEL
	help
	  Say Y here to add some extra checks and diagnostics to GPIO calls.
	  These checks help ensure that GPIOs have been properly initialized
	  before they are used, and that sleeping calls are not made from
	  non-sleeping contexts.  They can make bitbanged serial protocols
	  slower.  The diagnostics help catch the type of setup errors
	  that are most common when setting up new platforms or boards.

config GPIO_SYSFS
	bool "/sys/class/gpio/... (sysfs interface)"
	depends on SYSFS && EXPERIMENTAL
	help
	  Say Y here to add a sysfs interface for GPIOs.

	  This is mostly useful to work around omissions in a system's
	  kernel support.  Those are common in custom and semicustom
	  hardware assembled using standard kernels with a minimum of
	  custom patches.  In those cases, userspace code may import
	  a given GPIO from the kernel, if no kernel driver requested it.

	  Kernel drivers may also request that a particular GPIO be
	  exported to userspace; this can be useful when debugging.

config GPIO_GENERIC
	tristate


config UX500_GPIO_AB8500
	bool "ST-Ericsson AB8500 Mixed Signal Circuit gpio functions"
	depends on AB8500_CORE
	help
	  Select this to enable the AB8500 IC GPIO driver
endif
```

## arch/arm/mach-ux500/drivers/hwmon/Kconfig
```kconfig
#
# Hardware monitoring chip drivers configuration
#

menuconfig HWMON
	tristate "Hardware Monitoring support"
	depends on HAS_IOMEM
	default y
	help
	  Hardware monitoring devices let you monitor the hardware health
	  of a system. Most modern motherboards include such a device. It
	  can include temperature sensors, voltage sensors, fan speed
	  sensors and various additional features such as the ability to
	  control the speed of the fans.  If you want this support you
	  should say Y here and also to the specific driver(s) for your
	  sensors chip(s) below.

	  To find out which specific driver(s) you need, use the
	  sensors-detect script from the lm_sensors package.  Read
	  <file:Documentation/hwmon/userspace-tools> for details.

	  This support can also be built as a module.  If so, the module
	  will be called hwmon.

if HWMON

config HWMON_VID
	tristate
	default n

config HWMON_DEBUG_CHIP
	bool "Hardware Monitoring Chip debugging messages"
	default n
	help
	  Say Y here if you want the I2C chip drivers to produce a bunch of
	  debug messages to the system log.  Select this if you are having
	  a problem with I2C support and want to see more of what is going
	  on.

comment "Native drivers"

config SENSORS_AB8500
	tristate "AB8500 thermal monitoring"
	depends on AB8500_GPADC
	default n
	help
	  If you say yes here you get support for the thermal sensor part
	  of the AB8500 chip. The driver includes thermal management for
	  AB8500 die and two GPADC channels. The GPADC channel are preferably
	  used to access sensors outside the AB8500 chip.

	  This driver can also be built as a module.  If so, the module
	  will be called abx500-temp.

config SENSORS_AB5500
	tristate "AB5500 thermal monitoring"
	depends on AB5500_GPADC
	default n
	help
	  If you say yes here you get support for the thermal sensor part
	  of the AB5500 chip. The driver includes thermal management for
	  AB5500 die, pcb and RF XTAL temperature.

	  This driver can also be built as a module.  If so, the module
	  will be called abx500-temp.

config SENSORS_DBX500
	tristate "DBX500 thermal monitoring"
	depends on MFD_DB8500_PRCMU || MFD_DB5500_PRCMU || MFD_DBX540_PRCMU
	default n
	help
	  If you say yes here you get support for the thermal sensor part
	  of the DBX500 chip. The driver includes thermal management for
	  DBX500 die.

	  This driver can also be built as a module.  If so, the module
	  will be called dbx500_temp.

endif # HWMON
```

## arch/arm/mach-ux500/drivers/input/Kconfig
```kconfig
#
# Input device configuration
#

menu "Input device support"
	depends on !S390

if INPUT

source "arch/arm/mach-ux500/drivers/input/keyboard/Kconfig"

source "arch/arm/mach-ux500/drivers/input/touchscreen/Kconfig"

source "arch/arm/mach-ux500/drivers/input/misc/Kconfig"

endif

endmenu
```

## arch/arm/mach-ux500/drivers/input/keyboard/Kconfig
```kconfig
#
# Input core configuration
#

if INPUT_KEYBOARD
config UX500_KEYBOARD_GPIO
	tristate "GPIO Buttons"
	depends on GENERIC_GPIO
	help
	  This driver implements support for buttons connected
	  to GPIO pins of various CPUs (and some other chips).

	  Say Y here if your device has buttons connected
	  directly to such GPIO pins.  Your board-specific
	  setup logic must also provide a platform device,
	  with configuration data saying which GPIOs are used.

	  To compile this driver as a module, choose M here: the
	  module will be called gpio_keys.

config UX500_KEYBOARD_GPIO_POLLED
	tristate "Polled GPIO buttons"
	depends on UX500_KEYBOARD_GPIO
	select INPUT_POLLDEV
	help
	  This driver implements support for buttons connected
	  to GPIO pins that are not capable of generating interrupts.

	  Say Y here if your device has buttons connected
	  directly to such GPIO pins.  Your board-specific
	  setup logic must also provide a platform device,
	  with configuration data saying which GPIOs are used.

	  To compile this driver as a module, choose M here: the
	  module will be called gpio_keys_polled.

endif
```

## arch/arm/mach-ux500/drivers/input/misc/Kconfig
```kconfig
#
# Input misc drivers configuration
#
menuconfig INPUT_MISC
	bool "Miscellaneous devices"
	help
	  Say Y here, and a list of miscellaneous input drivers will be displayed.
	  Everything that didn't fit into the other categories is here. This option
	  doesn't affect the kernel.

	  If unsure, say Y.

if INPUT_MISC

config INPUT_AB8500_ACCDET
	bool "AB8500 AV Accessory detection"
	depends on AB8500_CORE && AB8500_GPADC && GPIO_AB8500
	help
	  Say Y here to enable AV accessory detection features for ST-Ericsson's
	  AB8500 Mix-Sig PMIC.

config INPUT_AB5500_ACCDET
	bool "AB5500 AV Accessory detection"
	depends on AB5500_CORE && AB5500_GPADC
	help
	  Say Y here to enable AV accessory detection features for ST-Ericsson's
	  AB5500 Mix-Sig PMIC.

config INPUT_AB8500_PONKEY
	tristate "AB5500/AB8500 Pon (PowerOn) Key"
	depends on AB5500_CORE || AB8500_CORE
	help
	  Say Y here to use the PowerOn Key for ST-Ericsson's AB5500/AB8500
	  Mix-Sig PMICs.

	  To compile this driver as a module, choose M here: the module
	  will be called ab8500-ponkey.

config INPUT_AB8505_MICRO_USB_DETECT
	bool "AB8505/AB9540 Micro USB device detection support"
	depends on AB8500_CORE
	help
	  Say Y here to enable Micro USB cable detection driver. This Driver
	  detects the accessory devices connected to the micro usb connector,
	  like micro usb headset, uart, carkit etc.

	  If unsure, say N.

endif
```
