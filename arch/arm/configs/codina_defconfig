## drivers/Kconfig
```kconfig
menu "Device Drivers"

source "drivers/base/Kconfig"

source "drivers/battery/Kconfig"

source "drivers/connector/Kconfig"

source "drivers/mtd/Kconfig"

source "drivers/of/Kconfig"

source "drivers/parport/Kconfig"

source "drivers/pnp/Kconfig"

source "drivers/block/Kconfig"

# misc before ide - BLK_DEV_SGIIOC4 depends on SGI_IOC4

if ARCH_U8500
source "u8500/drivers/misc/Kconfig"
endif

if !ARCH_U8500
source "drivers/misc/Kconfig"
endif

source "drivers/ide/Kconfig"

if ARCH_U8500
source "u8500/drivers/scsi/Kconfig"
endif

if !ARCH_U8500
source "drivers/scsi/Kconfig"
endif

source "drivers/ata/Kconfig"

source "drivers/md/Kconfig"

source "drivers/target/Kconfig"

source "drivers/message/fusion/Kconfig"

source "drivers/firewire/Kconfig"

source "drivers/message/i2o/Kconfig"

source "drivers/macintosh/Kconfig"

source "drivers/net/Kconfig"

source "drivers/isdn/Kconfig"

source "drivers/telephony/Kconfig"

# input before char - char/joystick depends on it. As does USB.

source "drivers/input/Kconfig"

if ARCH_U8500
source "u8500/drivers/input/Kconfig"
endif

source "drivers/char/Kconfig"

if ARCH_U8500
source "u8500/drivers/i2c/Kconfig"
endif

if !ARCH_U8500
source "drivers/i2c/Kconfig"
endif

if ARCH_U8500
source "u8500/drivers/spi/Kconfig"
endif

if !ARCH_U8500
source "drivers/spi/Kconfig"
endif

if ARCH_U8500
source "u8500/drivers/hsi/Kconfig"
endif

if !ARCH_U8500
source "drivers/hsi/Kconfig"
endif

source "drivers/pps/Kconfig"

source "drivers/ptp/Kconfig"

if ARCH_U8500
source "u8500/drivers/gpio/Kconfig"
endif

if !ARCH_U8500
source "drivers/gpio/Kconfig"
endif

source "drivers/w1/Kconfig"

if ARCH_U8500
source "u8500/drivers/power/Kconfig"
endif

if !ARCH_U8500
source "drivers/power/Kconfig"
endif

if ARCH_U8500
source "u8500/drivers/hwmon/Kconfig"
endif

if !ARCH_U8500
source "drivers/hwmon/Kconfig"
endif

source "drivers/thermal/Kconfig"

if ARCH_U8500
source "u8500/drivers/watchdog/Kconfig"
endif

if !ARCH_U8500
source "drivers/watchdog/Kconfig"
endif

source "drivers/ssb/Kconfig"

source "drivers/bcma/Kconfig"

if ARCH_U8500
source "u8500/drivers/mfd/Kconfig"
endif

if !ARCH_U8500
source "drivers/mfd/Kconfig"
endif

if ARCH_U8500
source "u8500/drivers/regulator/Kconfig"
endif

if !ARCH_U8500
source "drivers/regulator/Kconfig"
endif

if ARCH_U8500
source "u8500/drivers/media/Kconfig"
endif

if !ARCH_U8500
source "drivers/media/Kconfig"
endif

if ARCH_U8500
source "u8500/drivers/video/Kconfig"
endif

if !ARCH_U8500
source "drivers/video/Kconfig"
endif

source "sound/Kconfig"

source "drivers/hid/Kconfig"

if ARCH_U8500
source "u8500/drivers/usb/Kconfig"
endif

if !ARCH_U8500
source "drivers/usb/Kconfig"
endif

source "drivers/uwb/Kconfig"

if ARCH_U8500
source "u8500/drivers/mmc/Kconfig"
endif

if !ARCH_U8500
source "drivers/mmc/Kconfig"
endif

source "drivers/memstick/Kconfig"

source "drivers/leds/Kconfig"

source "drivers/nfc/Kconfig"

source "drivers/switch/Kconfig"

source "drivers/accessibility/Kconfig"

source "drivers/infiniband/Kconfig"

source "drivers/edac/Kconfig"

if ARCH_U8500
source "u8500/drivers/rtc/Kconfig"
endif

if !ARCH_U8500
source "drivers/rtc/Kconfig"
endif

if ARCH_U8500
source "u8500/drivers/dma/Kconfig"
endif

if !ARCH_U8500
source "drivers/dma/Kconfig"
endif

source "drivers/dca/Kconfig"

source "drivers/auxdisplay/Kconfig"

source "drivers/uio/Kconfig"

source "drivers/vlynq/Kconfig"

source "drivers/xen/Kconfig"

source "drivers/staging/Kconfig"

source "drivers/platform/Kconfig"

if ARCH_U8500
source "u8500/drivers/clk/Kconfig"
endif

if !ARCH_U8500
source "drivers/clk/Kconfig"
endif

source "drivers/tee/Kconfig"

source "drivers/hwspinlock/Kconfig"

if ARCH_U8500
source "u8500/drivers/clocksource/Kconfig"
endif

if !ARCH_U8500
source "drivers/clocksource/Kconfig"
endif

source "drivers/modem/Kconfig"

source "drivers/samsung/Kconfig"

source "drivers/sensor/Kconfig"

source "drivers/phone_svn/Kconfig"

source "drivers/interceptor/Kconfig" 

if ARCH_U8500
source "u8500/drivers/bcmdhd/Kconfig"
endif

endmenu
```

## drivers/clocksource/Kconfig
```kconfig
config CLKSRC_I8253
	bool

config CLKEVT_I8253
	bool

config I8253_LOCK
	bool

config CLKBLD_I8253
	def_bool y if CLKSRC_I8253 || CLKEVT_I8253 || I8253_LOCK

config CLKSRC_MMIO
	bool

config DW_APB_TIMER
	bool

config CLKSRC_DBX500_PRCMU
	bool "Clocksource PRCMU Timer"
	depends on UX500_SOC_DB5500 || UX500_SOC_DB8500
	default y if UX500_SOC_DB8500
	help
	  Use the always on PRCMU Timer as clocksource

config CLKSRC_DBX500_PRCMU_SCHED_CLOCK
	bool
	depends on CLKSRC_DBX500_PRCMU
	select HAVE_SCHED_CLOCK
	help
	  Use the always on PRCMU Timer as sched_clock

config CLKSRC_DB5500_MTIMER
	bool "Clocksource MTIMER"
	depends on UX500_SOC_DB5500
	default y
	help
	  Use the always on MTIMER as clocksource

config CLKSRC_DB5500_MTIMER_SCHED_CLOCK
	bool
	depends on CLKSRC_DB5500_MTIMER
	select HAVE_SCHED_CLOCK
	help
	  Use the always on PRCMU Timer as sched_clock
```

## drivers/cpuidle/Kconfig
```kconfig
config CPU_IDLE
	bool "CPU idle PM support"
	default ACPI
	depends on PM
	help
	  CPU idle is a generic framework for supporting software-controlled
	  idle processor power management.  It includes modular cross-platform
	  governors that can be swapped during runtime.

	  If you're using an ACPI-enabled platform, you should say Y here.

config CPU_IDLE_GOV_LADDER
	bool "Ladder governor (for periodic timer tick)"
	depends on CPU_IDLE
	default n

config CPU_IDLE_GOV_MENU
	bool "Menu governor (for tickless system)"
	depends on CPU_IDLE && NO_HZ
	default y

config DBX500_CPUIDLE
	bool "DBX500 CPUIdle support"
	depends on CPU_IDLE && (MFD_DB5500_PRCMU || MFD_DB8500_PRCMU || MFD_DBX540_PRCMU) && PM
	default y
	select GENERIC_CLOCKEVENTS_BROADCAST
	select DBX500_CONTEXT
	help
	  Add support for CPUIdle for U8500.

config DBX500_CPUIDLE_DEEPEST_STATE
	int "DBX500 Deepest sleep state"
	depends on DBX500_CPUIDLE
	default 1 if UX500_SOC_DB5500
	range 1 5
	default 3
	help
	  Set deepest sleep state. See the cstate struct in cpuidle-dbx500.c.

config DBX500_CPUIDLE_APDEEPIDLE
	bool "DBX500 CPUIdle ApDeepIdle"
	depends on DBX500_CPUIDLE
	default n
	help
	  Adds the power level ApDeepIdle, where APE is powered on while
	  ARM is powered off. Default n. Not supported on DB8500.

config DBX500_CPUIDLE_APDEEPSLEEP
	bool "DBX500 CPUIdle ApDeepSleep"
	depends on DBX500_CPUIDLE
	default n
	help
	  Adds the power level ApDeepSleep, where
	  ARM is powered off. Default n. Not supported on DB8500.

config DBX500_CPUIDLE_DEBUG
	bool "DBX500 CPUIdle debug"
	depends on DBX500_CPUIDLE && DEBUG_FS
	default y
	help
	  Add debugging support for CPUIdle for DBX500.
	  Needed for codina hardware.
```

## drivers/crypto/ux500/Kconfig
```kconfig
config CRYPTO_DEV_UX500_HASH
	tristate "UX500 crypto driver for HASH block"
	depends on ARCH_U8500
	select CRYPTO_ALGAPI
	select CRYPTO_HASH
	select CRYPTO_HMAC
        help
          This selects the UX500 hash driver for the HASH hardware.
          Depends on U8500/STM DMA if running in DMA mode.

config CRYPTO_DEV_UX500_DEBUG_INFO
	tristate "Enable UX500 crypto drivers debug info"
	help
	  This is to enable the debug info for UX500 crypto drivers.
```

## drivers/misc/audio_io_dev/Kconfig
```kconfig
#
# AB8500 Audio IO Device Driver configuration
#
config STE_AUDIO_IO_DEV
	bool "AB8500 Audio IO device driver"
	depends on ARCH_U8500 && AB8500_CORE && STM_MSP_I2S
	default y
	---help---
	  If you say Y here, you will enable the AB8500 Audio IO device driver.

	  If unsure, say N.
```

## drivers/misc/i2s/Kconfig
```kconfig
#
# U8500 I2S HW kernel configuration
#
config STM_I2S
	bool "U8500 I2S hardware driver"
	depends on ARCH_U8500 && STE_DMA40
	default y
	---help---
	  If you say Y here, you will enable the U8500 I2S hardware driver.

	  If unsure, say N.
config STM_MSP_I2S
	tristate "U8500 MSP_I2S hardware driver"
	depends on ARCH_U8500 && STE_DMA40 && STM_I2S
	default y
	---help---
	  If you say Y here, you will enable the U8500 MSP_I2S hardware driver.

	  If unsure, say N.
```

## drivers/modem/Kconfig
```kconfig
config MODEM
        bool "Modem Access Framework"
        default n
        help
         Add support for Modem Access Framework. It allows different
	 platform specific drivers to register modem access mechanisms
	 and allows transparent access to modem to the client drivers.

	 If unsure, say N.

config MODEM_U8500
	bool "Modem Access driver for STE U8500 platform"
	depends on MODEM
	default n
	help
	 Add support for Modem Access driver on STE U8500 platform which
	 uses Shared Memroy as IPC mechanism between Modem processor and
	 Application processor.

	 If unsure, say N.

source "drivers/modem/shrm/Kconfig"
```

## drivers/samsung/Kconfig
```kconfig
#
#
#

menu "Samsung Kernel Modules"

config SAMSUNG_MODULES
	tristate "Samsung Kernel Modules"
	default y
	help
	  Say Y to enable Samsung kernel modules. j4fs and param
	  modules are included.

config J4FS
	tristate "Samsung J4FS support"
	depends on SAMSUNG_MODULES
	default y
	help
	  Say Y to enable Samsung J4FS support.

config SAMSUNG_PARAM
	boolean "Samsung Param-Partition Support"
	depends on SAMSUNG_MODULES
	default y
	help
		Say Y to enable Samsung Param support.


source "drivers/samsung/startup_reason/Kconfig"

endmenu
```
