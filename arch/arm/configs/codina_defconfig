## arch/arm/mach-ux500/drivers/mfd/Kconfig
```kconfig
#
# Multifunction miscellaneous devices
#

if MFD_SUPPORT

config MFD_CORE
	tristate
	default n

config MFD_STMPE
	bool "Support STMicroelectronics STMPE"
	depends on (I2C=y || SPI_MASTER=y) && GENERIC_HARDIRQS
	select MFD_CORE
	help
	  Support for the STMPE family of I/O Expanders from
	  STMicroelectronics.

	  Currently supported devices are:

		STMPE811: GPIO, Touchscreen
		STMPE1601: GPIO, Keypad
		STMPE2401: GPIO, Keypad
		STMPE2403: GPIO, Keypad

	  This driver provides common support for accessing the device,
	  additional drivers must be enabled in order to use the functionality
	  of the device.  Currently available sub drivers are:

		GPIO: stmpe-gpio
		Keypad: stmpe-keypad
		Touchscreen: stmpe-ts

menu "STMPE Interface Drivers"
depends on MFD_STMPE

config STMPE_I2C
	bool "STMPE I2C Inteface"
	depends on I2C
	default y
	help
	  Enable I2C interface support for the STMPE devices.

	  The STMPE devices can be connected to different busses. This
	  enables the I2C interface for the devices.

config STMPE_SPI
	bool "STMPE SPI Inteface"
	depends on SPI_MASTER
	help
	  Enable SPI interface support for the STMPE devices.

	  The STMPE devices can be connected to different busses. This
	  enables the SPI interface for the devices.
endmenu

config AB5500_CORE
	bool "ST-Ericsson AB5500 Mixed Signal Circuit core functions"
	select MFD_CORE
	depends on GENERIC_HARDIRQS && ABX500_CORE
	help
	  Select this to enable the AB5500 Mixed Signal IC core
	  functionality. This connects to a AB5500 chip on the I2C bus via
	  the Power and Reset Management Unit (PRCMU). It exposes a number
	  of symbols needed for dependent devices to read and write
	  registers and subscribe to events from this multi-functional IC.
	  This is needed to use other features of the AB5500 such as
	  battery-backed RTC, charging control, Regulators, LEDs, vibrator,
	  system power and temperature, power management and ALSA sound.

config AB5500_GPADC
	bool "AB5500 GPADC driver"
	depends on AB5500_CORE
	default y
	help
	  AB5500 GPADC driver used to convert battery/usb voltage.

config ABX500_CORE
	bool "ST-Ericsson ABX500 Mixed Signal Circuit register functions"
	default y if ARCH_U300 || ARCH_U8500
	help
	  Say yes here if you have the ABX500 Mixed Signal IC family
	  chips. This core driver expose register access functions.
	  Functionality specific drivers using these functions can
	  remain unchanged when IC changes. Binding of the functions to
	  actual register access is done by the IC core driver.

config AB3100_CORE
	bool "ST-Ericsson AB3100 Mixed Signal Circuit core functions"
	depends on I2C=y && ABX500_CORE
	select MFD_CORE
	default y if ARCH_U300
	help
	  Select this to enable the AB3100 Mixed Signal IC core
	  functionality. This connects to a AB3100 on the I2C bus
	  and expose a number of symbols needed for dependent devices
	  to read and write registers and subscribe to events from
	  this multi-functional IC. This is needed to use other features
	  of the AB3100 such as battery-backed RTC, charging control,
	  LEDs, vibrator, system power and temperature, power management
	  and ALSA sound.

config AB3100_OTP
	tristate "ST-Ericsson AB3100 OTP functions"
	depends on AB3100_CORE
	default y if AB3100_CORE
	help
	  Select this to enable the AB3100 Mixed Signal IC OTP (one-time
	  programmable memory) support. This exposes a sysfs file to read
	  out OTP values.

config AB8500_CORE
	bool "ST-Ericsson AB8500 Mixed Signal Power Management chip"
	depends on GENERIC_HARDIRQS && ABX500_CORE
	select MFD_CORE
	help
	  Select this option to enable access to AB8500 power management
	  chip. This connects to U8500 either on the SSP/SPI bus (deprecated
	  since hardware version v1.0) or the I2C bus via PRCMU. It also adds
	  the irq_chip parts for handling the Mixed Signal chip events.
	  This chip embeds various other multimedia funtionalities as well.

config AB8500_I2C_CORE
	bool "AB8500 register access via PRCMU I2C"
	depends on AB8500_CORE
	default y
	help
	  This enables register access to the AB8500 chip via PRCMU I2C.
	  The AB8500 chip can be accessed via SPI or I2C. On DB8500 hardware
	  the I2C bus is connected to the Power Reset
	  and Mangagement Unit, PRCMU.

config AB8500_DENC
	bool "AB8500_DENC driver support(CVBS)"
	depends on AB8500_CORE
	help
	  Select this option to add driver support for analog TV out through
	  AB8500.


config AB8500_DEBUG
       bool "Enable debug info via debugfs"
       depends on AB8500_CORE && DEBUG_FS
       default y if DEBUG_FS
       help
         Select this option if you want debug information using the debug
         filesystem, debugfs.

config AB8500_GPADC
	bool "AB8500 GPADC driver"
	depends on AB8500_CORE
	default y
	help
	  AB8500 GPADC driver used to convert Acc and battery/ac/usb voltage.

config AB3550_CORE
        bool "ST-Ericsson AB3550 Mixed Signal Circuit core functions"
	select MFD_CORE
	depends on I2C=y && GENERIC_HARDIRQS && ABX500_CORE
	help
	  Select this to enable the AB3550 Mixed Signal IC core
	  functionality. This connects to a AB3550 on the I2C bus
	  and expose a number of symbols needed for dependent devices
	  to read and write registers and subscribe to events from
	  this multi-functional IC. This is needed to use other features
	  of the AB3550 such as battery-backed RTC, charging control,
	  LEDs, vibrator, system power and temperature, power management
	  and ALSA sound.

config DBX500_PRCMU
	bool "ST-Ericsson DBX500 Power Reset Control Management Unit"
	depends on UX500_SOC_DB8500
	help
	  Select this option to enable support for generic DBX500 Power
	  Reset and Control Management Unit. you have to select it for
	  enabling interface with other components like cpufreq,
	  cpuidle, prcmu-qos-power.


config MFD_DB8500_PRCMU
	bool "ST-Ericsson DB8500 Power Reset Control Management Unit"
	depends on UX500_SOC_DB8500
	select MFD_CORE
	select DBX500_PRCMU
	help
	  Select this option to enable support for the DB8500 Power Reset
	  and Control Management Unit. This is basically an autonomous
	  system controller running an XP70 microprocessor, which is accessed
	  through a register map.

config MFD_DBX540_PRCMU
	bool "ST-Ericsson DB9540/DB8540 Power Reset Control Management Unit"
	depends on UX500_SOC_DB8500
	select MFD_CORE
	help
	  Select this option to enable support for the DB9540/DB8540 Power Reset
	  and Control Management Unit. This is basically an autonomous
	  system controller running an XP70 microprocessor, which is accessed
	  through a register map.


config MFD_DB5500_PRCMU
	bool "ST-Ericsson DB5500 Power Reset Control Management Unit"
	depends on UX500_SOC_DB5500
	select MFD_CORE
	help
	  Select this option to enable support for the DB5500 Power Reset
	  and Control Management Unit. This is basically an autonomous
	  system controller running an XP70 microprocessor, which is accessed
	  through a register map.

endif
```

## arch/arm/mach-ux500/drivers/misc/Kconfig
```kconfig
#
# Misc strange devices
#

if MISC_DEVICES

config UX500_AB8500_PWM
	bool "AB8500 PWM support"
	depends on AB8500_CORE && ARCH_U8500
	select HAVE_PWM
	help
	  This driver exports functions to enable/disble/config/free Pulse
	  Width Modulation in the Analog Baseband Chip AB8500.
	  It is used by led and backlight driver to control the intensity.

config STE_TRACE_MODEM
	tristate "DB8500 trace Modem"
	depends on ARCH_U8500
	default n
	help
	 Select this option to enable modem tracing by APE

config DBX500_MLOADER
	tristate "Modem firmware loader for db8500"
	default n
	depends on UX500_SOC_DB8500 || UX500_SOC_DB5500
	help
	  Provides a user interface to load modem firmware on dbx500 SOCs

config HWMEM
	bool "Hardware memory driver"
	default n
	help
	  This driver provides a way to allocate contiguous system memory which
	  can be used by hardware. It also enables accessing hwmem allocated
	  memory buffers through a secure id which can be shared across processes.

config DISPDEV
	bool "Display overlay device"
	depends on FB_MCDE
	default n
	help
	  This driver provides a way to use a second overlay for a display (in
	  addition to the framebuffer). The device allows for registration of
	  userspace buffers to be used with the overlay.

config COMPDEV
	bool "Display composition device"
	depends on FB_MCDE && HWMEM
	default n
	help
	  This driver provides a way to use several overlays for a display.
	  This driver replaces the use of the framebuffer The device allows
	  for posting userspace buffers to be used with the overlays.

config COMPDEV_DEBUG
	bool "Display composition device debug"
	depends on COMPDEV
	default n
	help
	  Debug help for compdev.

config CLONEDEV
	bool "Display cloning device"
	depends on FB_MCDE && HWMEM && COMPDEV
	default n
	help
	  This driver provides a way to clone content between two compdev
	  devices.

config CLONEDEV_DEBUG
	bool "Display cloning device debug"
	depends on CLONEDEV
	default n
	help
	  This driver provides a way to clone content between two compdev
	  devices.

config UX500_NFC_PN544
        bool "NXP PN544 NFC Controller Driver"
        default n
        help
          NXP PN544 Near Field Communication controller support.

config U5500_MBOX
	bool "Mailbox support"
	depends on (UX500_SOC_DB5500 && U5500_MODEM_IRQ)
	default y
	help
	  Add support for U5500 mailbox communication with modem side
config SAMSUNG_JACK
	bool "3.5MM ear jack driver for Samsung devices on STE AB8500"
	depends on INPUT && AB8500_CORE
	default n
	---help---
	 This is 3.5MM ear jack driver for Samsung devices on STE AB8500.
	 If unsure, say N

config SAMSUNG_JACK_SW_WATERPROOF
	bool "prevent earjack mis-detect caused by water on STE AB8500"
	depends on SAMSUNG_JACK
	default n
	---help---
	 This is SW solution to prevent earjack mis-detect caused by water on STE AB8500.
	 This codes should only be applied to a device that does not have a defense circuit.
	 If unsure, say N

config U8500_SIM_DETECT
	bool "Sim hot swap detection support"
	depends on (MODEM && UX500_SOC_DB8500)
	default n
	help
	  Add support for sim hot swap detection support in U8500.Driver
	  basically wakes up the modem if its sleeping when sim hot plug
	  in/out has happened.

config UX500_USB_SWITCHER
	bool "USB Switch support"
	help
	  Say Y to enable support for USB switch devices.

config UX500_TORCH_FLASH
	bool "torch flash driver"
	default n
	help
	  This driver provides torch flash function.


source "arch/arm/mach-ux500/drivers/misc/tspdrv/Kconfig"

endif # MISC_DEVICES
```

## arch/arm/mach-ux500/drivers/modem/Kconfig
```kconfig
config MODEM
        bool "Modem Access Framework"
        default y
        help
         Add support for Modem Access Framework. It allows different
	 platform specific drivers to register modem access mechanisms
	 and allows transparent access to modem to the client drivers.

	 If unsure, say N.

config MODEM_U5500_MCDD
	tristate "Modem crash dump detection driver for STE U5500 platform"
	depends on (UX500_SOC_DB5500 && U5500_MODEM_IRQ && MODEM)
	default y
	help
	 Add support for Modem crash detection
	 driver for  STE U5500 platform.
	 And inform userspace.

         If unsure, say N.

config MODEM_U8500
	bool "Modem Access driver for STE U8500 platform"
	depends on MODEM
	default n
	help
	 Add support for Modem Access driver on STE U8500 platform which
	 uses Shared Memroy as IPC mechanism between Modem processor and
	 Application processor.

	 If unsure, say N.

source "arch/arm/mach-ux500/drivers/modem/shrm/Kconfig"

config U8500_KERNEL_CLIENT
	bool "U8500 kenrel client"
	depends on U8500_SHRM && UX500_SOC_DB8500
	default n
	help
	  This is the kernel client driver, responsible of receiving,
	  manupilating and sending response to and from modem.
	  If unsure, say N.
```

## arch/arm/mach-ux500/test/Kconfig
```kconfig
config DB8500_PWR_TEST
	bool "Power usage module test"
	depends on (UX500_SOC_DB8500 && DEBUG_FS && REGULATOR_AB8500_DEBUG)
	help
	  Add power module tests for idle
```
