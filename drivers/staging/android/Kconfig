## drivers/staging/android/Kconfig
```kconfig
menu "Android"

config ANDROID
	bool "Android Drivers"
	default N
	---help---
	  Enable support for various drivers needed on the Android platform

if ANDROID

config ANDROID_AB5500_TIMED_VIBRA
	bool "AB5500 Timed Output Vibrator"
	depends on AB5500_CORE
	depends on ANDROID_TIMED_OUTPUT
	default y
	help
	  Say Y here to enable linear/rotary vibrator driver using timed
	  output class device for ST-Ericsson's based on ST-Ericsson's
	  AB5500 Mix-Sig PMIC

config ANDROID_BINDER_IPC
	bool "Android Binder IPC Driver"
	default n

config ASHMEM
	bool "Enable the Anonymous Shared Memory Subsystem"
	default n
	depends on SHMEM || TINY_SHMEM
	help
	  The ashmem subsystem is a new shared memory allocator, similar to
	  POSIX SHM but with different behavior and sporting a simpler
	  file-based API.

config ANDROID_LOGGER
	tristate "Android log driver"
	default n

config ANDROID_PERSISTENT_RAM
	bool
	depends on HAVE_MEMBLOCK
	select REED_SOLOMON
	select REED_SOLOMON_ENC8
	select REED_SOLOMON_DEC8

config ANDROID_RAM_CONSOLE
	bool "Android RAM buffer console"
	depends on !S390 && !UML && HAVE_MEMBLOCK
	select ANDROID_PERSISTENT_RAM
	default n

config PERSISTENT_TRACER
	bool "Persistent function tracer"
	depends on HAVE_FUNCTION_TRACER
	select FUNCTION_TRACER
	select ANDROID_PERSISTENT_RAM
	help
	  persistent_trace traces function calls into a persistent ram
	  buffer that can be decoded and dumped after reboot through
	  /sys/kernel/debug/persistent_trace.  It can be used to
	  determine what function was last called before a reset or
	  panic.

	  If unsure, say N.

config ANDROID_TIMED_OUTPUT
	bool "Timed output class driver"
	default y

config ANDROID_TIMED_GPIO
	tristate "Android timed gpio driver"
	depends on GENERIC_GPIO && ANDROID_TIMED_OUTPUT
	default n

config ANDROID_LOW_MEMORY_KILLER
	bool "Android Low Memory Killer"
	default N
	---help---
	  Register processes to be killed when memory is low

config ANDROID_STE_TIMED_VIBRA
	bool "ST-Ericsson Timed Output Vibrator"
	depends on SND_SOC_AB8500
	depends on ANDROID_TIMED_OUTPUT
	default y
	help
	  ST-Ericsson's vibrator driver using timed output class device

source "drivers/staging/android/switch/Kconfig"

config ANDROID_INTF_ALARM_DEV
	bool "Android alarm driver"
	depends on RTC_CLASS
	default n
	help
	  Provides non-wakeup and rtc backed wakeup alarms based on rtc or
	  elapsed realtime, and a non-wakeup alarm on the monotonic clock.
	  Also exports the alarm interface to user-space.

endif # if ANDROID

endmenu
```

## drivers/staging/mmio/Kconfig
```kconfig
config U8500_MMIO
	bool "ST-Ericsson MMIO (Camera) Driver"
	depends on ARCH_U8500
	help
	  Enables the ST-Ericsson MMIO (Camera) Driver
```

## security/thumb/integrity/Kconfig
```kconfig
#
config INTEGRITY
	def_bool y
	depends on IMA

source security/thumb/integrity/ima/Kconfig
```

## sound/soc/ux500/Kconfig
```kconfig
#
# Ux500 SoC audio configuration
#

config SND_SOC_UX500
	bool "SoC Audio support for Ux500 platform"
	depends on SND_SOC && STM_I2S && STM_MSP_I2S
	default n
	help
		Say Y if you want to add support for the codecs attached to
		the I2S of the Ux500. You will also need
		to select the audio codec to be supported in the driver.

choice
	prompt "Codec to be used in Ux500 ASoC driver"
	depends on SND_SOC_UX500
	default SND_SOC_CG29XX

config SND_SOC_UX500_AB3550
	bool "AB3550"
	depends on AB3550_CORE
	select SND_SOC_AB3550
	help
		Say Y if you want to use AB3550 codec (Petronella MSA).

config SND_SOC_UX500_CG29XX
	bool "CG29xx"
	select SND_SOC_CG29XX
	help
		Say Y if you want to use CG29xx codec (Combo chip).

config SND_SOC_UX500_AV8100
	bool "AV8100"
	depends on AV8100
	select SND_SOC_AV8100
	help
		Say Y if you want to use AV8100 codec (HDMI chip).

endchoice

config SND_SOC_UX500_DEBUG
	bool "Activate Ux500 platform debug-mode (pr_debug)"
	depends on SND_SOC && STM_I2S && STM_MSP_I2S
	default n
	help
		Say Y if you want to add debug level prints for Ux500 code-files.
```

## u8500/drivers/char/Kconfig
```kconfig
#
# Character device configuration
#

source "drivers/char/hw_random/Kconfig"
source "drivers/char/hwreg/Kconfig"
```

## u8500/drivers/char/hw_random/Kconfig
```kconfig
#
# Hardware Random Number Generator (RNG) configuration
#

config HW_RANDOM_NOMADIK
	tristate "ST-Ericsson Nomadik Random Number Generator support"
	depends on HW_RANDOM && PLAT_NOMADIK
	---help---
	  This driver provides kernel-side support for the Random Number
	  Generator hardware found on ST-Ericsson SoCs (8815 and 8500).

	  To compile this driver as a module, choose M here: the
	  module will be called nomadik-rng.

	  If unsure, say Y.
```

## u8500/drivers/input/Kconfig
```kconfig
source "u8500/drivers/input/keyboard/Kconfig"
source "u8500/drivers/input/misc/Kconfig"
source "u8500/drivers/input/touchscreen/Kconfig"
```

## u8500/drivers/input/keyboard/Kconfig
```kconfig
config KEYBOARD_GPIO_U8500
	tristate "GPIO Buttons"
	depends on GENERIC_GPIO
	help
	  This driver implements support for buttons connected
	  to GPIO pins of various CPUs (and some other chips).

	  Say Y here if your device has buttons connected
	  directly to such GPIO pins.  Your board-specific
	  setup logic must also provide a platform device,
	  with configuration data saying which GPIOs are used.

	  To compile this driver as a module, choose M here: the
	  module will be called gpio_keys.

source "u8500/drivers/input/keyboard/cypress/Kconfig"
```

## u8500/drivers/input/keyboard/cypress/Kconfig
```kconfig
#
# Cypress touchkey configuration
#

config KEYBOARD_CYPRESS_TOUCH_U8500
	tristate "Cypress touchkey support"
	default N
	help
	  Say Y here to enable the cypress touchkey.

	  To compile this driver as a module, choose M here.
```

## u8500/drivers/input/misc/Kconfig
```kconfig
#
# Input misc drivers configuration
#

config INPUT_AB8500_ACCDET_U8500
	bool "AB8500 AV Accessory detection"
	depends on AB8500_CORE && AB8500_GPADC && GPIO_AB8500
	help
	  Say Y here to enable AV accessory detection features for ST-Ericsson's
	  AB8500 Mix-Sig PMIC.

config INPUT_AB8500_PONKEY_U8500
	tristate "AB5500/AB8500 Pon (PowerOn) Key"
	depends on AB5500_CORE || AB8500_CORE
	help
	  Say Y here to use the PowerOn Key for ST-Ericsson's AB5500/AB8500
	  Mix-Sig PMICs.

	  To compile this driver as a module, choose M here: the module
	  will be called ab8500-ponkey.

config INPUT_AB8505_MICRO_USB_DETECT_U8500
	bool "AB8505/AB9540 Micro USB device detection support"
	depends on AB8500_CORE
	help
	  Say Y here to enable Micro USB cable detection driver. This Driver
	  detects the accessory devices connected to the micro usb connector,
	  like micro usb headset, uart, carkit etc.

	  If unsure, say N.
```

## u8500/drivers/input/touchscreen/Kconfig
```kconfig
#
# Touchscreen driver configuration
#
config TOUCHSCREEN_ZINITIX_BT404_U8500
	tristate "Zinitix BT404 Touchscreens"
	depends on I2C
	default n
	help
		Say Y if you want support for Zinitix bt404 touchscreen
		controllers.
config TOUCHSCREEN_ZINITIX_U8500
	bool "Zinitix Touchscreens"
	depends on I2C
	default n
	help
		Say Y if you want support for Zinitix  touchscreen
		controllers.
config TOUCHSCREEN_ATMEL_MXT224E_U8500
	bool "Atmel MXT224E Touchscreen Interface"
	depends on I2C
	default n
	help
		Say Y here if you want support for atmel_224E touchscreen controllers.
		To compile this driver as a module, choose M here: the
		module will be called atmel_mxt224E.

config TOUCHSCREEN_SWEEP2WAKE_U8500
        tristate "Sweep2Wake for touchscreens"
        default n

config TOUCHSCREEN_SWEEP2WAKE_WAKELOCK_U8500
	depends on TOUCHSCREEN_SWEEP2WAKE
        bool "Sweep2Wake for touchscreens"
        default n

config TOUCHSCREEN_DOUBLETAP2WAKE_U8500
        tristate "DoubleTap2Wake for touchscreens"
        default n

config TOUCHSCREEN_DOUBLETAP2WAKE_WAKELOCK_U8500
	depends on TOUCHSCREEN_DOUBLETAP2WAKE
        bool "DoubleTap2Wake for touchscreens"
        default n
```

## u8500/drivers/media/dvb/Kconfig
```kconfig
#
# DVB device configuration
#

config DVB_MAX_ADAPTERS
	int "maximum number of DVB/ATSC adapters"
	depends on DVB_CORE
	default 8
	range 1 255
	help
	  Maximum number of DVB/ATSC adapters. Increasing this number
	  increases the memory consumption of the DVB subsystem even
	  if a much lower number of DVB/ATSC adapters is present.
	  Only values in the range 4-32 are tested.

	  If you are unsure about this, use the default value 8

config DVB_DYNAMIC_MINORS
	bool "Dynamic DVB minor allocation"
	depends on DVB_CORE
	default n
	help
	  If you say Y here, the DVB subsystem will use dynamic minor
	  allocation for any device that uses the DVB major number.
	  This means that you can have more than 4 of a single type
	  of device (like demuxes and frontends) per adapter, but udev
	  will be required to manage the device nodes.

	  If you are unsure about this, say N here.

menuconfig DVB_CAPTURE_DRIVERS
	bool "DVB/ATSC adapters"
	depends on DVB_CORE
	default y
	---help---
	  Say Y to select Digital TV adapters

if DVB_CAPTURE_DRIVERS && DVB_CORE

comment "Supported SAA7146 based PCI Adapters"
	depends on DVB_CORE && PCI && I2C
source "u8500/drivers/media/dvb/ttpci/Kconfig"

comment "Supported USB Adapters"
	depends on DVB_CORE && USB && I2C
source "u8500/drivers/media/dvb/dvb-usb/Kconfig"
source "u8500/drivers/media/dvb/ttusb-budget/Kconfig"
source "u8500/drivers/media/dvb/ttusb-dec/Kconfig"
source "u8500/drivers/media/dvb/siano/Kconfig"

comment "Supported FlexCopII (B2C2) Adapters"
	depends on DVB_CORE && (PCI || USB) && I2C
source "u8500/drivers/media/dvb/b2c2/Kconfig"

comment "Supported BT878 Adapters"
	depends on DVB_CORE && PCI && I2C
source "u8500/drivers/media/dvb/bt8xx/Kconfig"

comment "Supported Pluto2 Adapters"
	depends on DVB_CORE && PCI && I2C
source "u8500/drivers/media/dvb/pluto2/Kconfig"

comment "Supported SDMC DM1105 Adapters"
	depends on DVB_CORE && PCI && I2C
source "u8500/drivers/media/dvb/dm1105/Kconfig"

comment "Supported FireWire (IEEE 1394) Adapters"
	depends on DVB_CORE && FIREWIRE
source "u8500/drivers/media/dvb/firewire/Kconfig"

comment "Supported Earthsoft PT1 Adapters"
	depends on DVB_CORE && PCI && I2C
source "u8500/drivers/media/dvb/pt1/Kconfig"

comment "Supported Mantis Adapters"
	depends on DVB_CORE && PCI && I2C
	source "u8500/drivers/media/dvb/mantis/Kconfig"

comment "Supported nGene Adapters"
	depends on DVB_CORE && PCI && I2C
	source "u8500/drivers/media/dvb/ngene/Kconfig"

comment "Supported DVB Frontends"
	depends on DVB_CORE
source "u8500/drivers/media/dvb/frontends/Kconfig"

endif # DVB_CAPTURE_DRIVERS
```

## u8500/drivers/sensor/Kconfig
```kconfig
menuconfig NEW_SENSORS
	bool "Sensors Support"
	help
	  Say Y to enable Sensors support.  This allows control of supported
	  Sensors.

if NEW_SENSORS

source "u8500/drivers/sensor/alps/Kconfig"
source "u8500/drivers/sensor/proximity/Kconfig"
source "u8500/drivers/sensor/orientation/Kconfig"
source "u8500/drivers/sensor/mpu3050/Kconfig"
source "u8500/drivers/sensor/compass/Kconfig"

endif # NEW_SENSORS
```

## u8500/drivers/staging/Kconfig
```kconfig
source "u8500/drivers/staging/android/Kconfig"

source "u8500/drivers/staging/cg2900/Kconfig"

#source "u8500/drivers/staging/cw1200/Kconfig"

source "u8500/drivers/staging/mmio/Kconfig"

source "u8500/drivers/staging/nmf-cm/Kconfig"

source "u8500/drivers/staging/camera_flash/Kconfig"
```

## u8500/drivers/tty/serial/Kconfig
```kconfig
#
# Serial device configuration
#

config SERIAL_AMBA_PL010_U8500
	tristate "ARM AMBA PL010 serial port support"
	depends on ARM_AMBA && (BROKEN || !ARCH_VERSATILE)
	select SERIAL_CORE
	help
	  This selects the ARM(R) AMBA(R) PrimeCell PL010 UART.  If you have
	  an Integrator/AP or Integrator/PP2 platform, or if you have a
	  Cirrus Logic EP93xx CPU, say Y or M here.

	  If unsure, say N.

config SERIAL_AMBA_PL010_CONSOLE_U8500
	bool "Support for console on AMBA serial port"
	depends on SERIAL_AMBA_PL010_U8500=y
	select SERIAL_CORE_CONSOLE
	---help---
	  Say Y here if you wish to use an AMBA PrimeCell UART as the system
	  console (the system console is the device which receives all kernel
	  messages and warnings and which allows logins in single user mode).

	  Even if you say Y here, the currently visible framebuffer console
	  (/dev/tty0) will still be used as the system console by default, but
	  you can alter that using a kernel command line option such as
	  "console=ttyAM0". (Try "man bootparam" or see the documentation of
	  your boot loader (lilo or loadlin) about how to pass options to the
	  kernel at boot time.)

config SERIAL_AMBA_PL011_U8500
	tristate "ARM AMBA PL011 serial port support"
	depends on ARM_AMBA
	select SERIAL_CORE
	help
	  This selects the ARM(R) AMBA(R) PrimeCell PL011 UART.  If you have
	  an Integrator/PP2, Integrator/CP or Versatile platform, say Y or M
	  here.

	  If unsure, say N.

config SERIAL_AMBA_PL011_CONSOLE_U8500
	bool "Support for console on AMBA serial port"
	depends on SERIAL_AMBA_PL011_U8500=y
	select SERIAL_CORE_CONSOLE
	---help---
	  Say Y here if you wish to use an AMBA PrimeCell UART as the system
	  console (the system console is the device which receives all kernel
	  messages and warnings and which allows logins in single user mode).

	  Even if you say Y here, the currently visible framebuffer console
	  (/dev/tty0) will still be used as the system console by default, but
	  you can alter that using a kernel command line option such as
	  "console=ttyAMA0". (Try "man bootparam" or see the documentation of
	  your boot loader (lilo or loadlin) about how to pass options to the
	  kernel at boot time.)
```

## u8500/drivers/video/omap2/Kconfig
```kconfig
config OMAP2_VRAM
	bool

config OMAP2_VRFB
	bool

source "u8500/drivers/video/omap2/dss/Kconfig"
source "u8500/drivers/video/omap2/omapfb/Kconfig"
source "u8500/drivers/video/omap2/displays/Kconfig"
```

## u8500/sound/aoa/Kconfig
```kconfig
menuconfig SND_AOA
	tristate "Apple Onboard Audio driver"
	depends on PPC_PMAC
	select SND_PCM
	---help---
	This option enables the new driver for the various
	Apple Onboard Audio components.

if SND_AOA

source "u8500/sound/aoa/fabrics/Kconfig"

source "u8500/sound/aoa/codecs/Kconfig"

source "u8500/sound/aoa/soundbus/Kconfig"

endif	# SND_AOA
```
